/*
 * Copyright (c) 2020 Denis Fortin
 *
 * SPDX-License-Identifier: MIT
 */

#include "tdh70.dtsi"

&kscan0 {
	col-gpios
		= <&pro_micro_d  9 GPIO_ACTIVE_HIGH>
		, <&pro_micro_d  8 GPIO_ACTIVE_HIGH>
		, <&pro_micro_d  7 GPIO_ACTIVE_HIGH>
		, <&pro_micro_d  6 GPIO_ACTIVE_HIGH>
		, <&pro_micro_d  5 GPIO_ACTIVE_HIGH>
		, <&pro_micro_d  4 GPIO_ACTIVE_HIGH>
		, <&pro_micro_d  3 GPIO_ACTIVE_HIGH>
		;
};

