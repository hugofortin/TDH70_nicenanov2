## config/boards/shields/tdh70/Kconfig.shield
```kconfig
# Copyright (c) 2021 Denis Fortin
# SPDX-License-Identifier: MIT

config SHIELD_TDH70_LEFT
	def_bool $(shields_list_contains,tdh70_left)

config SHIELD_TDH70_RIGHT
	def_bool $(shields_list_contains,tdh70_right)
```

## config/west.yml
```yaml
manifest:
  remotes:
    - name: Nis2
      url-base: https://github.com/Nis2/
  projects:
    - name: zmk
      remote: Nis2
      revision: main
      import: app/west.yml
  self:
    path: config
```
